## CMakeLists.txt
```
# SPDX-License-Identifier: Apache-2.0

cmake_minimum_required(VERSION 3.20.0)
find_package(Zephyr REQUIRED HINTS $ENV{ZEPHYR_BASE})
project(OpenBlink)

# Generate mrubyc autogen files
add_custom_target(mrubyc_autogen
    COMMAND make autogen
    WORKING_DIRECTORY ${CMAKE_CURRENT_SOURCE_DIR}/mrubyc
    COMMENT "Generating mrubyc autogen files"
)

add_dependencies(app mrubyc_autogen)

target_sources(app PRIVATE
                    src/main.c
                    src/app/blink.c
                    src/app/comm.c
                    src/app/init.c
                    src/app/mrubyc_vm.c
                    src/app/storage.c
                    src/api/api.c
                    src/api/ble.c
                    src/api/blink.c
                    src/api/input.c
                    src/api/led.c
                    src/api/symbol.c
                    src/drv/ble.c
                    src/drv/ble_blink.c
                    src/drv/gpio.c
                    src/lib/mrubyc/hal.c
                    mrubyc/src/alloc.c
                    mrubyc/src/c_array.c
                    mrubyc/src/c_hash.c
                    mrubyc/src/c_math.c
                    mrubyc/src/c_numeric.c
                    mrubyc/src/c_object.c
                    mrubyc/src/c_proc.c
                    mrubyc/src/c_range.c
                    mrubyc/src/c_string.c
                    mrubyc/src/class.c
                    mrubyc/src/console.c
                    mrubyc/src/error.c
                    mrubyc/src/global.c
                    mrubyc/src/keyvalue.c
                    mrubyc/src/load.c
                    mrubyc/src/mrblib.c
                    mrubyc/src/rrt0.c
                    mrubyc/src/symbol.c
                    mrubyc/src/value.c
                    mrubyc/src/vm.c)

target_include_directories(app PRIVATE ${CMAKE_CURRENT_SOURCE_DIR}/src/lib/mrubyc ${CMAKE_CURRENT_SOURCE_DIR}/mrubyc/src)
```

## prj.conf
```kconfig
#
# Copyright (c) 2021 Nordic Semiconductor
#
# SPDX-License-Identifier: LicenseRef-Nordic-5-Clause
#

####################
# Build
####################
CONFIG_CPP=n
CONFIG_DEBUG_OPTIMIZATIONS=n
CONFIG_SIZE_OPTIMIZATIONS=y
CONFIG_PICOLIBC=y
CONFIG_TIMEOUT_64BIT=n
CONFIG_FPU=y
CONFIG_COMPILER_OPT="-D_DEFAULT_SOURCE -DMRBC_SCHEDULER_EXIT=1 -DMRBC_USE_FLOAT=1 -DMRBC_USE_MATH=1 -DMAX_VM_COUNT=5" # mruby/c VM settings

####################
# Bluetooth LE
####################
CONFIG_BT=y
CONFIG_BT_PERIPHERAL=y
CONFIG_BT_DEVICE_NAME="OpenBlink"
CONFIG_BT_DEVICE_NAME_DYNAMIC=y
CONFIG_BT_CTLR_TX_PWR_PLUS_8=y
CONFIG_BT_SETTINGS=y
CONFIG_BT_MAX_CONN=1
CONFIG_BT_MAX_PAIRED=1

# Human-readable HCI/security error strings for logging
CONFIG_BT_HCI_ERR_TO_STR=y

# Security Manager Protocol
CONFIG_BT_SMP=y
CONFIG_BT_SMP_SC_PAIR_ONLY=n

# Bonding is currently disabled. When enabling bonding in the future:
#   1. Set CONFIG_BT_BONDABLE=y
#   2. Remove the bt_unpair() call in ble_init() that clears bonds on boot
#   3. Review CONFIG_BT_MAX_PAIRED — increase if multiple peers are expected
#   4. Review CONFIG_BT_GATT_AUTO_RESUBSCRIBE — set to 'y' so that bonded
#      peers automatically restore CCCD subscriptions on reconnection
#   5. Review CONFIG_BT_ATT_RETRY_ON_SEC_ERR — set to 'y' if GATT operations
#      should be retried after security elevation instead of failing immediately
#   6. Consider adding bt_conn_auth_cb / bt_conn_auth_info_cb for passkey
#      display, confirmation, and pairing status reporting
#   7. Ensure init_factory_reset() still calls bt_unpair() for user-triggered
#      bond clearing
CONFIG_BT_BONDABLE=n
CONFIG_BT_CENTRAL=n
CONFIG_BT_GATT_DYNAMIC_DB=y
CONFIG_BT_ATT_PREPARE_COUNT=2
CONFIG_BT_PRIVACY=y
CONFIG_BT_CTLR_PRIVACY=y
CONFIG_BT_TRANSMIT_POWER_CONTROL=y
CONFIG_BT_SCA_UPDATE=y

CONFIG_BT_USER_DATA_LEN_UPDATE=y
CONFIG_BT_USER_PHY_UPDATE=y
CONFIG_BT_GAP_AUTO_UPDATE_CONN_PARAMS=n

CONFIG_NET_BUF=y
CONFIG_STREAM_FLASH=y

# MTU exchange is handled directly in ble.c using bt_gatt_exchange_mtu()
CONFIG_BT_L2CAP_TX_MTU=498
CONFIG_BT_BUF_ACL_TX_SIZE=251
CONFIG_BT_BUF_ACL_RX_SIZE=502
CONFIG_BT_CTLR_DATA_LENGTH_MAX=251

CONFIG_BT_CTLR_PHY_2M=y
CONFIG_BT_CTLR_PHY_CODED=y
CONFIG_BT_CTLR_SDC_MAX_CONN_EVENT_LEN_DEFAULT=4000000

# GATT Client support is required even for peripheral-only devices because
# bt_gatt_exchange_mtu() (used in ble.c on_connected) depends on it.
# The MTU exchange response handler (att_mtu_rsp) and the exchange_mtu
# implementation in gatt.c are both guarded by CONFIG_BT_GATT_CLIENT.
# Without it, MTU remains at the default 23 bytes, severely limiting throughput.
CONFIG_BT_GATT_CLIENT=y

# GATT Discovery Manager is an nRF Connect SDK helper for central/client
# service discovery. Not used in this peripheral-only application.
CONFIG_BT_GATT_DM=n

####################
# Flash (ZMS storage, Settings storage)
####################
CONFIG_FLASH=y
CONFIG_FLASH_PAGE_LAYOUT=y
CONFIG_FLASH_MAP=y
CONFIG_ZMS=y
CONFIG_ZMS_DATA_CRC=y
CONFIG_SETTINGS=y
CONFIG_SETTINGS_ZMS=y
CONFIG_SETTINGS_ZMS_CUSTOM_SECTOR_COUNT=y
CONFIG_SETTINGS_ZMS_SECTOR_COUNT=8

####################
# Drivers and peripherals
####################
CONFIG_GPIO=y
CONFIG_REBOOT=y
CONFIG_CRC=y

####################
# Clock
####################
CONFIG_CLOCK_CONTROL_NRF_K32SRC_RC=y
CONFIG_CLOCK_CONTROL_NRF_K32SRC_XTAL=n
CONFIG_CLOCK_CONTROL_NRF_K32SRC_500PPM=y
CONFIG_CLOCK_CONTROL_NRF_K32SRC_SYNTH=n

####################
# Thread
####################
CONFIG_TIMESLICING=y
CONFIG_TIMESLICE_SIZE=10
CONFIG_TIMESLICE_PRIORITY=0

####################
# Memory protection
####################
CONFIG_ARM_MPU=y
CONFIG_THREAD_STACK_INFO=y
CONFIG_THREAD_CUSTOM_DATA=n

####################
# Security
####################
#CONFIG_NRF_APPROTECT_LOCK=y

####################
# HW ID
####################
CONFIG_HWINFO=y
CONFIG_HWINFO_NRF=y
CONFIG_HW_ID_LIBRARY=y
CONFIG_HW_ID_LIBRARY_SOURCE_DEVICE_ID=y

####################
# Version
# $ west bindesc dump build/merged.hex
# https://docs.zephyrproject.org/latest/develop/west/zephyr-cmds.html#west-bindesc
####################
CONFIG_BINDESC=y
CONFIG_BINDESC_DEFINE=y
CONFIG_BINDESC_DEFINE_VERSION=y
CONFIG_BINDESC_APP_VERSION_MAJOR=y
CONFIG_BINDESC_APP_VERSION_MINOR=y
CONFIG_BINDESC_APP_VERSION_PATCHLEVEL=y
CONFIG_BINDESC_APP_VERSION_STRING=y
CONFIG_BINDESC_DEFINE_BUILD_TIME=n
CONFIG_BINDESC_BUILD_DATE_TIME_STRING=n
CONFIG_BINDESC_BUILD_TIME_ALWAYS_REBUILD=n
CONFIG_BINDESC_KERNEL_VERSION_STRING=y
CONFIG_BINDESC_KERNEL_VERSION_MAJOR=y
CONFIG_BINDESC_KERNEL_VERSION_MINOR=y
CONFIG_BINDESC_KERNEL_VERSION_PATCHLEVEL=y
CONFIG_BOOT_BANNER=n
CONFIG_BOOT_DELAY=0

#########################
# DEBUG
####################
CONFIG_DEBUG=y
CONFIG_CONSOLE=y
CONFIG_UART_CONSOLE=n
CONFIG_STDOUT_CONSOLE=n
CONFIG_EARLY_CONSOLE=y
CONFIG_RTT_CONSOLE=y
CONFIG_USE_SEGGER_RTT=y
CONFIG_SEGGER_RTT_BUFFER_SIZE_UP=2048
CONFIG_PRINTK=y
#CONFIG_PRINTK_SYNC=y
CONFIG_REQUIRES_FLOAT_PRINTF=y
CONFIG_CBPRINTF_NANO=n
CONFIG_CBPRINTF_LIBC_SUBSTS=n

####################
# Logging
####################
CONFIG_LOG=y
CONFIG_LOG_MODE_MINIMAL=y
#CONFIG_LOG_MODE_DEFERRED=n
#CONFIG_LOG_MODE_IMMEDIATE=n
#CONFIG_LOG_MODE_OVERFLOW=y

CONFIG_LOG_OVERRIDE_LEVEL=0
# - 0 OFF, do not override
# - 1 ERROR, override to write LOG_LEVEL_ERR
# - 2 WARNING, override to write LOG_LEVEL_WRN
# - 3 INFO, override to write LOG_LEVEL_INFO
# - 4 DEBUG, override to write LOG_LEVEL_DBG

#########################
# Thread analyzer
####################
#CONFIG_THREAD_ANALYZER=y
#CONFIG_THREAD_ANALYZER_USE_PRINTK=y
#CONFIG_THREAD_ANALYZER_AUTO=y
#CONFIG_THREAD_ANALYZER_AUTO_INTERVAL=5
#CONFIG_THREAD_NAME=y

####################
# Disable Bluetooth features not needed
####################
#CONFIG_BT_DEBUG_NONE=y
#CONFIG_BT_ASSERT=n
#CONFIG_BT_DATA_LEN_UPDATE=n
#CONFIG_BT_PHY_UPDATE=n
#CONFIG_BT_GATT_CACHING=n
#CONFIG_BT_GATT_SERVICE_CHANGED=n
#CONFIG_BT_GAP_PERIPHERAL_PREF_PARAMS=n
#CONFIG_BT_SETTINGS_CCC_LAZY_LOADING=y
#CONFIG_BT_HCI_VS_EXT=n
CONFIG_BT_GATT_READ_MULTIPLE=n
CONFIG_BT_GATT_READ_MULT_VAR_LEN=n
CONFIG_BT_CTLR_LE_PING=n
# Do not retry ATT operations after security errors.
# When bonding is enabled, consider setting this to 'y' so that GATT read/write
# requests that fail due to insufficient encryption are retried automatically
# after the security level is elevated through pairing.
CONFIG_BT_ATT_RETRY_ON_SEC_ERR=n

# Do not auto-resubscribe CCCD on reconnection.
# When bonding is enabled, consider setting this to 'y' so that bonded peers
# automatically restore their notification/indication subscriptions without
# requiring the central to re-write the CCCD after each reconnection.
CONFIG_BT_GATT_AUTO_RESUBSCRIBE=n

# Do not require an explicit CCCD write before allowing GATT notifications.
# The application still checks bt_gatt_is_subscribed() before sending, so
# notifications are only delivered to subscribed clients. This setting is
# relevant when bonding is disabled because CCCD state is not persisted.
# When bonding is enabled and CONFIG_BT_GATT_AUTO_RESUBSCRIBE=y,
# consider setting this to 'y' to enforce strict subscription flow.
CONFIG_BT_GATT_ENFORCE_SUBSCRIPTION=n

####################
# Reduce Bluetooth buffers
####################
#CONFIG_BT_BUF_EVT_DISCARDABLE_COUNT=1
#CONFIG_BT_BUF_EVT_DISCARDABLE_SIZE=43
#CONFIG_BT_BUF_EVT_RX_COUNT=2
#CONFIG_BT_CONN_TX_MAX=2
#CONFIG_BT_L2CAP_TX_BUF_COUNT=2
#CONFIG_BT_BUF_ACL_TX_COUNT=3
#CONFIG_BT_BUF_ACL_TX_SIZE=27
```

## src/blink.c
```c
/*
 * SPDX-License-Identifier: BSD-3-Clause
 * SPDX-FileCopyrightText: Copyright (c) 2025 ViXion Inc. All Rights Reserved.
 */
/**
 * @file blink.c
 * @brief Blink protocol parser and bytecode slot management
 * @details Implements the transport-independent Blink protocol ('D', 'P',
 * 'R', 'L') including CRC16 verification, and the slot API that validates
 * arguments before delegating to the platform storage HAL.
 */
#include "openblink/blink.h"

#include <stdbool.h>
#include <stddef.h>
#include <stdint.h>
#include <stdio.h>
#include <string.h>

#include "openblink/vm.h"

/** @brief Blink protocol version */
#define BLINK_VERSION 0x01U

/** @brief Command code for data chunk transfer */
#define BLINK_CMD_DATA 'D'
/** @brief Command code for program execution */
#define BLINK_CMD_PROG 'P'
/** @brief Command code for device reset */
#define BLINK_CMD_RESET 'R'
/** @brief Command code for bytecode reload */
#define BLINK_CMD_RELOAD 'L'

/** @brief Size of the common frame header ({version, command}) in bytes */
#define BLINK_HEADER_SIZE ((openblink_length_t)2U)
/** @brief Size of a 'D' frame header ({header, offset, size}) in bytes */
#define BLINK_DATA_HEADER_SIZE ((openblink_length_t)6U)
/** @brief Size of a 'P' frame ({header, length, crc, slot, reserved}) */
#define BLINK_PROGRAM_FRAME_SIZE ((openblink_length_t)8U)

/** @brief Buffer for the bytecode being received via 'D' frames */
static uint8_t receive_buffer[OPENBLINK_MAX_BYTECODE_SIZE];

/**
 * @brief Checks whether a slot number is valid
 *
 * @param slot Slot number to check
 * @return bool true if the slot is within 1..OPENBLINK_SLOT_COUNT
 */
static bool slot_is_valid(const openblink_slot_t slot) {
  return (1U <= slot) && ((openblink_slot_t)OPENBLINK_SLOT_COUNT >= slot);
}

/**
 * @brief Reads a 16-bit little-endian value from a byte sequence
 *
 * @param bytes Pointer to the first byte
 * @return uint16_t Decoded value
 */
static uint16_t read_le16(const uint8_t* const bytes) {
  return (uint16_t)((uint16_t)bytes[0] | ((uint16_t)bytes[1] << 8));
}

/**
 * @brief Calculates the CRC16 of a byte sequence
 *
 * @details Bit-reflected CRC16 with polynomial 0xD175 (reflected form) and
 * seed 0xFFFF, matching the checksum used by the OpenBlink IDEs.
 *
 * @param data Pointer to the bytes
 * @param len Number of bytes
 * @return uint16_t CRC16 value
 */
static uint16_t crc16(const uint8_t* const data, const size_t len) {
  uint16_t crc = 0xFFFFU;
  for (size_t i = 0; len > i; i++) {
    crc ^= (uint16_t)data[i];
    for (uint8_t bit = 0; 8U > bit; bit++) {
      if (0U != (crc & 0x0001U)) {
        crc = (uint16_t)((crc >> 1) ^ 0xD175U);
      } else {
        crc = (uint16_t)(crc >> 1);
      }
    }
  }
  return crc;
}

/**
 * @brief Sends a NUL-terminated response string to the host
 *
 * @param msg Response string
 */
static void send_response_string(const char* const msg) {
  (void)openblink_hal_send_response(msg, (openblink_length_t)strlen(msg));
}

/**
 * @brief Processes a data chunk frame (BLINK_CMD_DATA)
 *
 * @param frame Pointer to the frame bytes
 * @param len Length of the frame in bytes
 * @return openblink_status_t OPENBLINK_STATUS_OK on success
 */
static openblink_status_t receive_command_data(const uint8_t* const frame,
                                               const openblink_length_t len) {
  if (BLINK_DATA_HEADER_SIZE > len) {
    send_response_string("ERROR: Blink data size error");
    return OPENBLINK_STATUS_ERROR;
  }

  const uint16_t offset = read_le16(&frame[2]);
  const uint16_t size = read_le16(&frame[4]);

  if ((openblink_length_t)(BLINK_DATA_HEADER_SIZE + size) != len) {
    send_response_string("ERROR: Blink data size error");
    return OPENBLINK_STATUS_ERROR;
  }

  if (((uint32_t)offset + (uint32_t)size) >
      (uint32_t)OPENBLINK_MAX_BYTECODE_SIZE) {
    send_response_string("ERROR: Size exceeds buffer limits");
    return OPENBLINK_STATUS_ERROR;
  }

  memcpy(&receive_buffer[offset], &frame[BLINK_DATA_HEADER_SIZE], size);
  return OPENBLINK_STATUS_OK;
}

/**
 * @brief Processes a program execution frame (BLINK_CMD_PROG)
 *
 * @param frame Pointer to the frame bytes
 * @param len Length of the frame in bytes
 * @return openblink_status_t OPENBLINK_STATUS_OK on success
 */
static openblink_status_t receive_command_program(
    const uint8_t* const frame, const openblink_length_t len) {
  if (BLINK_PROGRAM_FRAME_SIZE != len) {
    send_response_string("ERROR: Blink size mismatch");
    return OPENBLINK_STATUS_ERROR;
  }

  const uint16_t length = read_le16(&frame[2]);
  const uint16_t crc = read_le16(&frame[4]);
  const openblink_slot_t slot = (openblink_slot_t)frame[6];

  if ((uint32_t)length > (uint32_t)OPENBLINK_MAX_BYTECODE_SIZE) {
    send_response_string("ERROR: Size exceeds buffer limits");
    return OPENBLINK_STATUS_ERROR;
  }

  if (!slot_is_valid(slot)) {
    send_response_string("ERROR: Invalid slot");
    memset(receive_buffer, 0, sizeof(receive_buffer));
    return OPENBLINK_STATUS_INVALID_ARG;
  }

  openblink_status_t status = OPENBLINK_STATUS_ERROR;
  if (crc16(receive_buffer, (size_t)length) == crc) {
    status = openblink_slot_store(slot, receive_buffer,
                                  (openblink_length_t)length, NULL);
    if (OPENBLINK_STATUS_OK == status) {
      char msg[32];
      (void)snprintf(msg, sizeof(msg), "OK slot:%u", (unsigned int)slot);
      send_response_string(msg);
    } else {
      send_response_string("ERROR: Blink program error");
    }
  } else {
    send_response_string("ERROR: CRC mismatch");
  }

  memset(receive_buffer, 0, sizeof(receive_buffer));
  return status;
}

openblink_status_t openblink_receive(const void* const data,
                                     const openblink_length_t len) {
  const uint8_t* const frame = (const uint8_t*)data;

  if ((NULL == frame) || (BLINK_HEADER_SIZE > len)) {
    send_response_string("ERROR: Blink size mismatch");
    return OPENBLINK_STATUS_ERROR;
  }

  if (BLINK_VERSION != frame[0]) {
    send_response_string("ERROR: Blink version mismatch");
    return OPENBLINK_STATUS_ERROR;
  }

  openblink_status_t status = OPENBLINK_STATUS_OK;
  switch (frame[1]) {
    case BLINK_CMD_DATA:
      status = receive_command_data(frame, len);
      break;
    case BLINK_CMD_PROG:
      status = receive_command_program(frame, len);
      break;
    case BLINK_CMD_RESET:
      status = openblink_hal_reboot();
      break;
    case BLINK_CMD_RELOAD:
      status = openblink_vm_restart();
      break;
    default:
      send_response_string("ERROR: Blink unknown type");
      status = OPENBLINK_STATUS_ERROR;
      break;
  }
  return status;
}

openblink_status_t openblink_slot_store(const openblink_slot_t slot,
                                        const void* const data,
                                        const openblink_length_t len,
                                        openblink_length_t* const written_len) {
  if ((!slot_is_valid(slot)) || (NULL == data) ||
      ((openblink_length_t)OPENBLINK_MAX_BYTECODE_SIZE < len)) {
    return OPENBLINK_STATUS_INVALID_ARG;
  }

  openblink_length_t written = 0;
  const openblink_status_t status =
      openblink_hal_storage_write(slot, data, len, &written);
  if (NULL != written_len) {
    *written_len = written;
  }
  return status;
}

openblink_status_t openblink_slot_load(const openblink_slot_t slot,
                                       void* const data, const size_t capacity,
                                       openblink_length_t* const read_len) {
  if ((!slot_is_valid(slot)) || (NULL == data)) {
    return OPENBLINK_STATUS_INVALID_ARG;
  }

  openblink_length_t read = 0;
  const openblink_status_t status =
      openblink_hal_storage_read(slot, data, capacity, &read);
  if (NULL != read_len) {
    *read_len = read;
  }
  return status;
}

openblink_status_t openblink_slot_get_data_length(
    const openblink_slot_t slot, openblink_length_t* const len) {
  if ((!slot_is_valid(slot)) || (NULL == len)) {
    return OPENBLINK_STATUS_INVALID_ARG;
  }
  return openblink_hal_storage_get_length(slot, len);
}

openblink_status_t openblink_slot_delete(const openblink_slot_t slot) {
  if (!slot_is_valid(slot)) {
    return OPENBLINK_STATUS_INVALID_ARG;
  }
  return openblink_hal_storage_delete(slot);
}
```

## src/blink_class.c
```c
/*
 * SPDX-License-Identifier: BSD-3-Clause
 * SPDX-FileCopyrightText: Copyright (c) 2025 ViXion Inc. All Rights Reserved.
 */
/**
 * @file blink_class.c
 * @brief Blink class for mruby/c
 * @details Implements the Blink class exposing Blink.lock and Blink.unlock to
 * Ruby scripts so critical sections can be protected from VM reloads.
 */
#include <mrubyc.h>

#include "internal.h"
#include "openblink/vm.h"

/**
 * @brief Implementation of the lock method for the Blink class
 *
 * @param vm Pointer to the mruby/c VM
 * @param v Pointer to the method arguments
 * @param argc Number of arguments
 */
static void c_lock_blink(mrb_vm* vm, mrb_value* v, int argc) {
  (void)vm;
  (void)argc;
  if (openblink_vm_lock()) {
    SET_TRUE_RETURN();
  } else {
    SET_FALSE_RETURN();
  }
}

/**
 * @brief Implementation of the unlock method for the Blink class
 *
 * @param vm Pointer to the mruby/c VM
 * @param v Pointer to the method arguments
 * @param argc Number of arguments
 */
static void c_unlock_blink(mrb_vm* vm, mrb_value* v, int argc) {
  (void)vm;
  (void)argc;
  if (openblink_vm_unlock()) {
    SET_TRUE_RETURN();
  } else {
    SET_FALSE_RETURN();
  }
}

openblink_status_t openblink_define_blink_class(void) {
  mrb_class* class_blink = mrbc_define_class(0, "Blink", mrbc_class_object);
  if (NULL == class_blink) {
    return OPENBLINK_STATUS_ERROR;
  }
  mrbc_define_method(0, class_blink, "lock", c_lock_blink);
  mrbc_define_method(0, class_blink, "unlock", c_unlock_blink);
  return OPENBLINK_STATUS_OK;
}
```

## src/internal.h
```c
/*
 * SPDX-License-Identifier: BSD-3-Clause
 * SPDX-FileCopyrightText: Copyright (c) 2025 ViXion Inc. All Rights Reserved.
 */
/**
 * @file internal.h
 * @brief Internal declarations shared between OpenBlink core sources
 */
#ifndef OPENBLINK_INTERNAL_H
#define OPENBLINK_INTERNAL_H

#include "openblink/types.h"

/**
 * @brief Defines the Blink class (Blink.lock / Blink.unlock) for mruby/c
 *
 * @return openblink_status_t OPENBLINK_STATUS_OK on success
 */
openblink_status_t openblink_define_blink_class(void);

#endif /* OPENBLINK_INTERNAL_H */
```

## src/vm.c
```c
/*
 * SPDX-License-Identifier: BSD-3-Clause
 * SPDX-FileCopyrightText: Copyright (c) 2025 ViXion Inc. All Rights Reserved.
 */
/**
 * @file vm.c
 * @brief mruby/c VM lifecycle management
 * @details Implements the VM run loop, restart handling, and the VM lock used
 * by Blink.lock/Blink.unlock. Bytecode and heap buffers are statically
 * allocated so the hosting thread only needs a small stack.
 */
#include "openblink/vm.h"

#include <mrubyc.h>
#include <stdbool.h>
#include <stddef.h>
#include <stdint.h>
#include <string.h>

#include "internal.h"
#include "openblink/blink.h"

/** @brief Heap memory for the mruby/c VM */
static uint8_t memory_pool[OPENBLINK_VM_HEAP_SIZE];

/** @brief Bytecode buffers, one per slot */
static uint8_t bytecode[OPENBLINK_SLOT_COUNT][OPENBLINK_MAX_BYTECODE_SIZE];

/** @brief Task control blocks, one per slot */
static mrbc_tcb* tcb[OPENBLINK_SLOT_COUNT];

/** @brief Set by openblink_vm_restart() and consumed by openblink_vm_main() */
static volatile bool restart_requested;

/**
 * @brief Loads the bytecode for one slot into its buffer
 *
 * @details Attempts to load from non-volatile storage first; falls back to
 * the platform factory default program.
 *
 * @param slot Slot to load (1..OPENBLINK_SLOT_COUNT)
 * @param buffer Destination buffer
 * @param capacity Capacity of the buffer in bytes
 * @return bool true if bytecode is available in the buffer
 */
static bool load_slot_bytecode(const openblink_slot_t slot,
                               uint8_t* const buffer, const size_t capacity) {
  openblink_length_t stored_len = 0;
  if ((OPENBLINK_STATUS_OK ==
       openblink_slot_get_data_length(slot, &stored_len)) &&
      (0U < stored_len) && ((size_t)stored_len <= capacity)) {
    openblink_length_t read_len = 0;
    if ((OPENBLINK_STATUS_OK ==
         openblink_slot_load(slot, buffer, capacity, &read_len)) &&
        (0U < read_len)) {
      return true;
    }
  }

  openblink_length_t default_len = 0;
  if ((OPENBLINK_STATUS_OK == openblink_hal_load_default_bytecode(
                                  slot, buffer, capacity, &default_len)) &&
      (0U < default_len)) {
    return true;
  }

  return false;
}

void openblink_vm_main(void) {
  while (1) {
    restart_requested = false;
    for (size_t i = 0; OPENBLINK_SLOT_COUNT > i; i++) {
      tcb[i] = NULL;
    }

    // mruby/c initialize (starts the tick timer via mrbc_hal_init())
    mrbc_init(memory_pool, OPENBLINK_VM_HEAP_SIZE);

    // Class, Method
    if (OPENBLINK_STATUS_OK != openblink_hal_define_api()) {
      console_print("ERROR: Failed to define platform API\n");
    }
    if (OPENBLINK_STATUS_OK != openblink_define_blink_class()) {
      console_print("ERROR: Failed to define Blink class\n");
    }

    // Load mruby bytecode and create tasks
    size_t task_count = 0;
    for (size_t i = 0; OPENBLINK_SLOT_COUNT > i; i++) {
      memset(bytecode[i], 0, sizeof(bytecode[i]));
      const openblink_slot_t slot = (openblink_slot_t)(i + 1U);
      if (load_slot_bytecode(slot, bytecode[i], sizeof(bytecode[i]))) {
        tcb[i] = mrbc_create_task(bytecode[i], NULL);
        if (NULL == tcb[i]) {
          console_print("ERROR: Failed to create task\n");
        } else {
          task_count++;
        }
      }
    }

    console_print("Blinked\n");

    if (0U < task_count) {
      mrbc_run();
    } else {
      // No runnable task; wait until a reload is requested.
      while (!restart_requested) {
        mrbc_hal_idle_cpu();
      }
    }

    // Clear the task pointers under the VM lock so a concurrent
    // openblink_vm_restart() never touches tasks freed by mrbc_cleanup().
    // If the lock cannot be acquired (e.g. a task ended while holding
    // Blink.lock), proceed anyway: the same holder also blocks
    // openblink_vm_restart(), so no restart can race with the cleanup.
    const bool locked = openblink_hal_vm_lock(OPENBLINK_VM_RESTART_TIMEOUT_MS);
    for (size_t i = 0; OPENBLINK_SLOT_COUNT > i; i++) {
      tcb[i] = NULL;
    }
    if (locked) {
      (void)openblink_hal_vm_unlock();
    }

    // mruby/c cleanup
    mrbc_cleanup();
  }
}

openblink_status_t openblink_vm_restart(void) {
  if (!openblink_hal_vm_lock(OPENBLINK_VM_RESTART_TIMEOUT_MS)) {
    return OPENBLINK_STATUS_ERROR;
  }

  restart_requested = true;
  for (size_t i = 0; OPENBLINK_SLOT_COUNT > i; i++) {
    if (NULL != tcb[i]) {
      mrbc_terminate_task(tcb[i]);
      mrbc_delete_task(tcb[i]);
    }
  }

  (void)openblink_hal_vm_unlock();
  return OPENBLINK_STATUS_OK;
}

bool openblink_vm_lock(void) {
  return openblink_hal_vm_lock(OPENBLINK_VM_LOCK_TIMEOUT_MS);
}

bool openblink_vm_unlock(void) { return openblink_hal_vm_unlock(); }
```
